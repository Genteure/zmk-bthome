## Kconfig
```kconfig
menuconfig ZMK_BTHOME
	bool "ZMK BTHome support"
	depends on ZMK_BLE
    select BT_EXT_ADV
	help
	  Enable sending BTHome sensor data over Bluetooth Low Energy
	  (BLE) advertisements from ZMK-powered keyboards.

if ZMK_BTHOME

config ZMK_BTHOME_ADV_TIMEOUT
	int "BTHome advertisements timeout (10ms units)"
	default 100	
	help
	  Advertisement timeout (in 10ms units) for each BTHome event.
	  Set to 0 to disable a timeout. Higher values increase reliability
	  of delivery at the cost of longer advertisement duration.

config ZMK_BTHOME_ADV_PACKETS
	int "BTHome advertisements packets"
	default 10	
	help
	  Number of advertisement "packets" (events) to send
	  for each BTHome event. Higher values increase reliability
	  of delivery at the cost of longer advertisement duration.

config ZMK_BTHOME_BATTERY_LEVEL
	bool "Report battery level"
	default y
    depends on ZMK_BATTERY_REPORTING
	help
	  Include battery level (percentage) in BTHome advertisements.
	  Disable to omit this sensor from payloads.

config ZMK_BTHOME_BATTERY_VOLTAGE
	bool "Report battery voltage"
	default y
    depends on ZMK_BTHOME_BATTERY_LEVEL
	help
	  Include battery voltage in BTHome advertisements.
	  Disable to omit this sensor from payloads.

config ZMK_BTHOME_DEVICE_NAME
	string "BTHome device name"
	default ZMK_KEYBOARD_NAME if ZMK_KEYBOARD_NAME != ""
	default "ZMK"
	help
	  BTHome advertised device name. Can be set to empty to omit
	  the name entirely.

config ZMK_BTHOME_DEVICE_NAME_NOT_EMPTY
	def_bool ZMK_BTHOME_DEVICE_NAME != ""

config ZMK_BTHOME_ENCRYPTION_KEY
	string "BTHome encryption key (hex)"
	default ""
	help
	  Provide a 16-byte key as 32 hexadecimal characters to enable
	  BTHome v2 encryption. Leave empty to send unencrypted payloads.

config ZMK_BTHOME_ENCRYPTION_ENABLED
	def_bool ZMK_BTHOME_ENCRYPTION_KEY != ""
	select CRYPTO
	select CRYPTO_MBEDTLS_SHIM
	select MBEDTLS_CIPHER_CCM_ENABLED

endif # ZMK_BTHOME

config ZMK_BEHAVIOR_BTHOME_BUTTON
	bool
	default y
	depends on DT_HAS_ZMK_BEHAVIOR_BTHOME_BUTTON_ENABLED
```

## dts/bindings/behaviors/zmk,behavior-bthome-button.yaml
```yaml
# SPDX-License-Identifier: MIT

description: BTHome button behavior

compatible: "zmk,behavior-bthome-button"

include: one_param.yaml
```
